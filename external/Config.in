## external/Config.in
```kconfig
menu "tiny_webui package"

source "$BR2_EXTERNAL_TINY_WEBUI_PATH/package/js-style-co-routine/Config.in"
source "$BR2_EXTERNAL_TINY_WEBUI_PATH/package/libsodium-new/Config.in"
source "$BR2_EXTERNAL_TINY_WEBUI_PATH/package/tev-cpp/Config.in"
source "$BR2_EXTERNAL_TINY_WEBUI_PATH/package/tui-app/Config.in"
source "$BR2_EXTERNAL_TINY_WEBUI_PATH/package/tui-server/Config.in"
source "$BR2_EXTERNAL_TINY_WEBUI_PATH/package/tiny-websocket/Config.in"

endmenu
```

## external/configs/tiny-webui-x64_defconfig
```kconfig
BR2_x86_64=y
BR2_TOOLCHAIN_EXTERNAL=y
BR2_TOOLCHAIN_EXTERNAL_BOOTLIN_X86_64_GLIBC_STABLE=y
BR2_CCACHE=y
BR2_OPTIMIZE_S=y
BR2_PER_PACKAGE_DIRECTORIES=y
BR2_TARGET_GENERIC_HOSTNAME="tiny-webui"
BR2_TARGET_GENERIC_ISSUE="Welcome to Tiny-WebUI"
BR2_INIT_NONE=y
BR2_ROOTFS_MERGED_USR=y
BR2_SYSTEM_DEFAULT_PATH="/bin:/sbin:/usr/bin:/usr/sbin"
BR2_TARGET_TZ_INFO=y
BR2_TARGET_TZ_ZONELIST="etcetera"
BR2_ROOTFS_OVERLAY="$(BR2_EXTERNAL_TINY_WEBUI_PATH)/overlay"
BR2_ROOTFS_POST_BUILD_SCRIPT="$(BR2_EXTERNAL_TINY_WEBUI_PATH)/scripts/post-build.sh"
BR2_PACKAGE_BUSYBOX_CONFIG_FRAGMENT_FILES="$(BR2_EXTERNAL_TINY_WEBUI_PATH)/configs/busybox-fragment.config"
BR2_PACKAGE_CA_CERTIFICATES=y
BR2_PACKAGE_WOLFSSL=y
BR2_PACKAGE_LIBATOMIC_OPS=y
BR2_PACKAGE_NGINX=y
# BR2_PACKAGE_NGINX_HTTP_SSI_MODULE is not set
# BR2_PACKAGE_NGINX_HTTP_USERID_MODULE is not set
# BR2_PACKAGE_NGINX_HTTP_AUTH_BASIC_MODULE is not set
# BR2_PACKAGE_NGINX_HTTP_AUTOINDEX_MODULE is not set
# BR2_PACKAGE_NGINX_HTTP_GEO_MODULE is not set
# BR2_PACKAGE_NGINX_HTTP_SPLIT_CLIENTS_MODULE is not set
# BR2_PACKAGE_NGINX_HTTP_REFERER_MODULE is not set
# BR2_PACKAGE_NGINX_HTTP_FASTCGI_MODULE is not set
# BR2_PACKAGE_NGINX_HTTP_UWSGI_MODULE is not set
# BR2_PACKAGE_NGINX_HTTP_SCGI_MODULE is not set
# BR2_PACKAGE_NGINX_HTTP_MEMCACHED_MODULE is not set
# BR2_PACKAGE_NGINX_HTTP_EMPTY_GIF_MODULE is not set
# BR2_PACKAGE_NGINX_HTTP_UPSTREAM_IP_HASH_MODULE is not set
# BR2_PACKAGE_NGINX_HTTP_UPSTREAM_LEAST_CONN_MODULE is not set
# BR2_PACKAGE_NGINX_HTTP_UPSTREAM_KEEPALIVE_MODULE is not set
# BR2_PACKAGE_NGINX_HTTP_UPSTREAM_RANDOM_MODULE is not set
# BR2_PACKAGE_NGINX_HTTP_UPSTREAM_ZONE_MODULE is not set
BR2_PACKAGE_S6=y
```

## external/package/js-style-co-routine/Config.in
```kconfig
config BR2_PACKAGE_JS_STYLE_CO_ROUTINE
    bool "js-style-co-routine"
    help
        JavaScript Style C++ Co-Routine Library
```

## external/package/libsodium-new/Config.in
```kconfig
config BR2_PACKAGE_LIBSODIUM_NEW
	bool "libsodium-new"
	help
	  A modern and easy-to-use crypto library.

	  http://libsodium.org/

if BR2_PACKAGE_LIBSODIUM_NEW

config BR2_PACKAGE_LIBSODIUM_NEW_FULL
	bool "all functions"
	default y
	help
	  Build all seldom used and obsolete functions. Without
	  this option, only the minimal set of normally used
	  functions is built.

endif
```

## external/package/tev-cpp/Config.in
```kconfig
config BR2_PACKAGE_TEV_CPP
    bool "tev-cpp"
    help
        Tiny event loop C++
```

## external/package/tiny-websocket/Config.in
```kconfig
config BR2_PACKAGE_TINY_WEBSOCKET
    bool "tiny-websocket"
    help
        Tiny WebSocket library
```

## external/package/tui-app/Config.in
```kconfig
config BR2_PACKAGE_TUI_APP
    bool "tui-app"
    default y
    help
        Tiny WebUI web app
```

## external/package/tui-server/Config.in
```kconfig
config BR2_PACKAGE_TUI_SERVER
    bool "tui-server"
    default y
    select BR2_PACKAGE_LIBCURL
    select BR2_PACKAGE_LIBWEBSOCKETS
    select BR2_PACKAGE_SQLITE
    select BR2_PACKAGE_UTIL_LINUX
    select BR2_PACKAGE_UTIL_LINUX_LIBUUID
    select BR2_PACKAGE_LIBSODIUM_NEW
    select BR2_PACKAGE_LIBSODIUM_NEW_FULL
    select BR2_PACKAGE_JSON_FOR_MODERN_CPP
    select BR2_PACKAGE_TEV_CPP
    select BR2_PACKAGE_JS_STYLE_CO_ROUTINE
    help
        Tiny WebUI server
```
